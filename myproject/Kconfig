## myproject/Kconfig
```kconfig
# SPDX-License-Identifier: GPL-2.0

menu "My project"

source "myproject/of_test/Kconfig"

source "myproject/i2c-sht2x/Kconfig"

source "myproject/myi2c-controller-bcm2711/Kconfig

endmenu
```

## myproject/my_platform_led/Kconfig
```kconfig
# SPDX-License-Identifier: GPL-2.0

config MY_PLATFORM_LED
    tristate "MY_PLATFORM_LED"
```

## myproject/myi2c-controller-bcm2711/Kconfig
```kconfig
# SPDX-License-Identifier: GPL-2.0

config MYI2C_CONTROLLER_BCM2711
    tristate "MYI2C_CONTROLLER_BCM2711"
```
